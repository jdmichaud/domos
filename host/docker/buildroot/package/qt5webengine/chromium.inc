CHROMIUM_LICENSE_FILES = \
	src/3rdparty/chromium/base/third_party/dmg_fp/LICENSE \
	src/3rdparty/chromium/base/third_party/dynamic_annotations/LICENSE \
	src/3rdparty/chromium/base/third_party/icu/LICENSE \
	src/3rdparty/chromium/base/third_party/libevent/LICENSE \
	src/3rdparty/chromium/base/third_party/nspr/LICENSE \
	src/3rdparty/chromium/base/third_party/superfasthash/LICENSE \
	src/3rdparty/chromium/base/third_party/symbolize/LICENSE \
	src/3rdparty/chromium/base/third_party/valgrind/LICENSE \
	src/3rdparty/chromium/base/third_party/xdg_mime/LICENSE \
	src/3rdparty/chromium/base/third_party/xdg_user_dirs/LICENSE \
	src/3rdparty/chromium/buildtools/LICENSE \
	src/3rdparty/chromium/buildtools/third_party/libc++abi/trunk/LICENSE.TXT \
	src/3rdparty/chromium/buildtools/third_party/libc++/trunk/LICENSE.TXT \
	src/3rdparty/chromium/chrome/third_party/chromevox/LICENSE \
	src/3rdparty/chromium/chrome/third_party/chromevox/third_party/closure-library/LICENSE \
	src/3rdparty/chromium/LICENSE \
	src/3rdparty/chromium/LICENSE.chromium_os \
	src/3rdparty/chromium/mojo/public/LICENSE \
	src/3rdparty/chromium/net/third_party/mozilla_security_manager/LICENSE \
	src/3rdparty/chromium/net/third_party/nss/LICENSE \
	src/3rdparty/chromium/ppapi/LICENSE \
	src/3rdparty/chromium/testing/gmock/LICENSE \
	src/3rdparty/chromium/testing/gmock/scripts/generator/LICENSE \
	src/3rdparty/chromium/testing/gtest/LICENSE \
	src/3rdparty/chromium/third_party/accessibility_test_framework/LICENSE \
	src/3rdparty/chromium/third_party/angle/LICENSE \
	src/3rdparty/chromium/third_party/angle/src/third_party/compiler/LICENSE \
	src/3rdparty/chromium/third_party/angle/src/third_party/libXNVCtrl/LICENSE \
	src/3rdparty/chromium/third_party/angle/src/third_party/murmurhash/LICENSE \
	src/3rdparty/chromium/third_party/apache-portable-runtime/LICENSE \
	src/3rdparty/chromium/third_party/apache_velocity/LICENSE \
	src/3rdparty/chromium/third_party/apple_apsl/LICENSE \
	src/3rdparty/chromium/third_party/appurify-python/LICENSE \
	src/3rdparty/chromium/third_party/bintrees/LICENSE.txt \
	src/3rdparty/chromium/third_party/blanketjs/LICENSE \
	src/3rdparty/chromium/third_party/blimp_fonts/LICENSE \
	src/3rdparty/chromium/third_party/blimp_fonts/LICENSE.Apache \
	src/3rdparty/chromium/third_party/blimp_fonts/LICENSE.OFL \
	src/3rdparty/chromium/third_party/boringssl/src/LICENSE \
	src/3rdparty/chromium/third_party/boringssl/src/third_party/android-cmake/LICENSE \
	src/3rdparty/chromium/third_party/bouncycastle/LICENSE \
	src/3rdparty/chromium/third_party/brotli/LICENSE \
	src/3rdparty/chromium/third_party/bspatch/LICENSE \
	src/3rdparty/chromium/third_party/cardboard-java/LICENSE \
	src/3rdparty/chromium/third_party/catapult/third_party/py_vulcanize/third_party/rcssmin/bench/LICENSE.cssmin \
	src/3rdparty/chromium/third_party/catapult/third_party/py_vulcanize/third_party/rcssmin/LICENSE \
	src/3rdparty/chromium/third_party/catapult/third_party/py_vulcanize/third_party/rjsmin/LICENSE \
	src/3rdparty/chromium/third_party/catapult/tracing/third_party/chai/LICENSE \
	src/3rdparty/chromium/third_party/catapult/tracing/third_party/css-element-queries/LICENSE \
	src/3rdparty/chromium/third_party/catapult/tracing/third_party/d3/LICENSE \
	src/3rdparty/chromium/third_party/catapult/tracing/third_party/gl-matrix/LICENSE.md \
	src/3rdparty/chromium/third_party/catapult/tracing/third_party/jszip/LICENSE.markdown \
	src/3rdparty/chromium/third_party/catapult/tracing/third_party/mocha/LICENSE \
	src/3rdparty/chromium/third_party/ced/LICENSE \
	src/3rdparty/chromium/third_party/ced/src/LICENSE \
	src/3rdparty/chromium/third_party/chaijs/LICENSE \
	src/3rdparty/chromium/third_party/checkstyle/LICENSE \
	src/3rdparty/chromium/third_party/checkstyle/LICENSE.apache20 \
	src/3rdparty/chromium/third_party/class-dump/LICENSE \
	src/3rdparty/chromium/third_party/closure_compiler/LICENSE \
	src/3rdparty/chromium/third_party/closure_linter/LICENSE \
	src/3rdparty/chromium/third_party/crashpad/crashpad/LICENSE \
	src/3rdparty/chromium/third_party/crashpad/crashpad/third_party/apple_cctools/cctools/APPLE_LICENSE \
	src/3rdparty/chromium/third_party/crashpad/crashpad/third_party/apple_cf/APPLE_LICENSE \
	src/3rdparty/chromium/third_party/crashpad/crashpad/third_party/getopt/LICENSE \
	src/3rdparty/chromium/third_party/cros_system_api/LICENSE \
	src/3rdparty/chromium/third_party/cros_system_api/MODULE_LICENSE_BSD \
	src/3rdparty/chromium/third_party/custom_tabs_client/LICENSE \
	src/3rdparty/chromium/third_party/d3/src/LICENSE \
	src/3rdparty/chromium/third_party/decklink/LICENSE \
	src/3rdparty/chromium/third_party/dom_distiller_js/LICENSE \
	src/3rdparty/chromium/third_party/drmemory/LICENSE \
	src/3rdparty/chromium/third_party/errorprone/LICENSE \
	src/3rdparty/chromium/third_party/espresso/LICENSE \
	src/3rdparty/chromium/third_party/ffmpeg/LICENSE.md \
	src/3rdparty/chromium/third_party/flatbuffers/LICENSE \
	src/3rdparty/chromium/third_party/flatbuffers/src/LICENSE.txt \
	src/3rdparty/chromium/third_party/flot/LICENSE.txt \
	src/3rdparty/chromium/third_party/fontconfig/LICENSE \
	src/3rdparty/chromium/third_party/freetype2/src/docs/LICENSE.TXT \
	src/3rdparty/chromium/third_party/freetype-android/src/docs/LICENSE.TXT \
	src/3rdparty/chromium/third_party/gardiner_mod/LICENSE \
	src/3rdparty/chromium/third_party/gif_player/LICENSE \
	src/3rdparty/chromium/third_party/glslang/LICENSE \
	src/3rdparty/chromium/third_party/grpc/LICENSE \
	src/3rdparty/chromium/third_party/grpc/src/php/ext/grpc/LICENSE \
	src/3rdparty/chromium/third_party/grpc/third_party/rake-compiler-dock/LICENSE.txt \
	src/3rdparty/chromium/third_party/guava/LICENSE \
	src/3rdparty/chromium/third_party/haha/LICENSE \
	src/3rdparty/chromium/third_party/hamcrest/LICENSE \
	src/3rdparty/chromium/third_party/hwcplus/LICENSE \
	src/3rdparty/chromium/third_party/iaccessible2/LICENSE \
	src/3rdparty/chromium/third_party/iccjpeg/LICENSE \
	src/3rdparty/chromium/third_party/icu4j/LICENSE \
	src/3rdparty/chromium/third_party/icu/LICENSE \
	src/3rdparty/chromium/third_party/icu/scripts/LICENSE \
	src/3rdparty/chromium/third_party/ijar/LICENSE \
	src/3rdparty/chromium/third_party/isimpledom/LICENSE \
	src/3rdparty/chromium/third_party/javax_inject/LICENSE \
	src/3rdparty/chromium/third_party/jinja2/LICENSE \
	src/3rdparty/chromium/third_party/jmake/LICENSE \
	src/3rdparty/chromium/third_party/jsoncpp/LICENSE \
	src/3rdparty/chromium/third_party/khronos/LICENSE \
	src/3rdparty/chromium/third_party/leakcanary/LICENSE \
	src/3rdparty/chromium/third_party/leveldatabase/src/LICENSE \
	src/3rdparty/chromium/third_party/libaddressinput/LICENSE \
	src/3rdparty/chromium/third_party/libaddressinput/src/cpp/LICENSE.chromium \
	src/3rdparty/chromium/third_party/libaddressinput/src/LICENSE \
	src/3rdparty/chromium/third_party/libFuzzer/LICENSE.TXT \
	src/3rdparty/chromium/third_party/libjpeg/LICENSE \
	src/3rdparty/chromium/third_party/libjpeg_turbo/LICENSE.md \
	src/3rdparty/chromium/third_party/libpng/LICENSE \
	src/3rdparty/chromium/third_party/libsecret/LICENSE \
	src/3rdparty/chromium/third_party/libsrtp/srtp/LICENSE \
	src/3rdparty/chromium/third_party/libsync/LICENSE \
	src/3rdparty/chromium/third_party/libudev/LICENSE \
	src/3rdparty/chromium/third_party/libvpx/source/libvpx/LICENSE \
	src/3rdparty/chromium/third_party/libvpx/source/libvpx/third_party/googletest/src/LICENSE \
	src/3rdparty/chromium/third_party/libvpx/source/libvpx/third_party/libwebm/LICENSE.TXT \
	src/3rdparty/chromium/third_party/libvpx/source/libvpx/third_party/x86inc/LICENSE \
	src/3rdparty/chromium/third_party/libwebm/source/LICENSE.TXT \
	src/3rdparty/chromium/third_party/libwebp/LICENSE \
	src/3rdparty/chromium/third_party/libXNVCtrl/LICENSE \
	src/3rdparty/chromium/third_party/libyuv/LICENSE \
	src/3rdparty/chromium/third_party/libyuv/LICENSE_THIRD_PARTY \
	src/3rdparty/chromium/third_party/libyuv/third_party/gflags/LICENSE \
	src/3rdparty/chromium/third_party/lzma_sdk/LICENSE \
	src/3rdparty/chromium/third_party/mach_override/LICENSE \
	src/3rdparty/chromium/third_party/markupsafe/LICENSE \
	src/3rdparty/chromium/third_party/mesa/LICENSE \
	src/3rdparty/chromium/third_party/mesa/src/src/gallium/drivers/radeon/LICENSE.TXT \
	src/3rdparty/chromium/third_party/minigbm/LICENSE \
	src/3rdparty/chromium/third_party/mocha/LICENSE \
	src/3rdparty/chromium/third_party/mockito/LICENSE \
	src/3rdparty/chromium/third_party/modp_b64/LICENSE \
	src/3rdparty/chromium/third_party/molokocacao/LICENSE \
	src/3rdparty/chromium/third_party/motemplate/LICENSE \
	src/3rdparty/chromium/third_party/mozilla/LICENSE \
	src/3rdparty/chromium/third_party/mt19937ar/LICENSE \
	src/3rdparty/chromium/third_party/netty4/LICENSE \
	src/3rdparty/chromium/third_party/netty-tcnative/LICENSE \
	src/3rdparty/chromium/third_party/openh264/src/LICENSE \
	src/3rdparty/chromium/third_party/openmax_dl/LICENSE \
	src/3rdparty/chromium/third_party/opus/src/LICENSE_PLEASE_READ.txt \
	src/3rdparty/chromium/third_party/ots/LICENSE \
	src/3rdparty/chromium/third_party/ow2_asm/LICENSE \
	src/3rdparty/chromium/third_party/pdfium/LICENSE \
	src/3rdparty/chromium/third_party/pdfium/third_party/bigint/LICENSE \
	src/3rdparty/chromium/third_party/pdfium/third_party/pymock/LICENSE.txt \
	src/3rdparty/chromium/third_party/pexpect/LICENSE \
	src/3rdparty/chromium/third_party/ply/LICENSE \
	src/3rdparty/chromium/third_party/polymer/v1_0/components-chromium/polymer/LICENSE.txt \
	src/3rdparty/chromium/third_party/proguard/LICENSE \
	src/3rdparty/chromium/third_party/protobuf/LICENSE \
	src/3rdparty/chromium/third_party/pycoverage/LICENSE \
	src/3rdparty/chromium/third_party/pyelftools/elftools/construct/LICENSE \
	src/3rdparty/chromium/third_party/pyelftools/LICENSE \
	src/3rdparty/chromium/third_party/pyftpdlib/src/LICENSE \
	src/3rdparty/chromium/third_party/pymock/LICENSE.txt \
	src/3rdparty/chromium/third_party/Python-Markdown/LICENSE.md \
	src/3rdparty/chromium/third_party/py_trace_event/src/LICENSE \
	src/3rdparty/chromium/third_party/pywebsocket/src/LICENSE \
	src/3rdparty/chromium/third_party/qunit/LICENSE \
	src/3rdparty/chromium/third_party/re2/LICENSE \
	src/3rdparty/chromium/third_party/re2/src/LICENSE \
	src/3rdparty/chromium/third_party/requests/LICENSE \
	src/3rdparty/chromium/third_party/robolectric/LICENSE \
	src/3rdparty/chromium/third_party/shaderc/LICENSE \
	src/3rdparty/chromium/third_party/shaderc/src/LICENSE \
	src/3rdparty/chromium/third_party/shaderc/src/third_party/LICENSE.glslang \
	src/3rdparty/chromium/third_party/shaderc/src/third_party/LICENSE.spirv-tools \
	src/3rdparty/chromium/third_party/simplejson/LICENSE.txt \
	src/3rdparty/chromium/third_party/sinonjs/LICENSE \
	src/3rdparty/chromium/third_party/skia/LICENSE \
	src/3rdparty/chromium/third_party/skia/platform_tools/android/third_party/ashmem/LICENSE \
	src/3rdparty/chromium/third_party/skia/third_party/etc1/LICENSE \
	src/3rdparty/chromium/third_party/skia/third_party/libpng/LICENSE \
	src/3rdparty/chromium/third_party/smhasher/LICENSE \
	src/3rdparty/chromium/third_party/SPIRV-Tools/LICENSE \
	src/3rdparty/chromium/third_party/SPIRV-Tools/src/LICENSE \
	src/3rdparty/chromium/third_party/sqlite4java/LICENSE \
	src/3rdparty/chromium/third_party/sqlite/LICENSE \
	src/3rdparty/chromium/third_party/sudden_motion_sensor/LICENSE \
	src/3rdparty/chromium/third_party/swiftshader/LICENSE \
	src/3rdparty/chromium/third_party/tcmalloc/LICENSE \
	src/3rdparty/chromium/third_party/tlslite/LICENSE \
	src/3rdparty/chromium/third_party/typ/LICENSE \
	src/3rdparty/chromium/third_party/ub-uiautomator/LICENSE \
	src/3rdparty/chromium/third_party/usb_ids/LICENSE \
	src/3rdparty/chromium/third_party/usrsctp/LICENSE \
	src/3rdparty/chromium/third_party/usrsctp/usrsctplib/LICENSE.md \
	src/3rdparty/chromium/third_party/v4l2capture/LICENSE \
	src/3rdparty/chromium/third_party/vulkan/LICENSE \
	src/3rdparty/chromium/third_party/wayland/LICENSE \
	src/3rdparty/chromium/third_party/wayland-protocols/LICENSE \
	src/3rdparty/chromium/third_party/wds/LICENSE \
	src/3rdparty/chromium/third_party/web-animations-js/LICENSE \
	src/3rdparty/chromium/third_party/webdriver/LICENSE \
	src/3rdparty/chromium/third_party/WebKit/LICENSE \
	src/3rdparty/chromium/third_party/WebKit/LICENSE_FOR_ABOUT_CREDITS \
	src/3rdparty/chromium/third_party/WebKit/Source/core/LICENSE-APPLE \
	src/3rdparty/chromium/third_party/WebKit/Source/core/LICENSE-LGPL-2 \
	src/3rdparty/chromium/third_party/WebKit/Source/core/LICENSE-LGPL-2.1 \
	src/3rdparty/chromium/third_party/WebKit/Source/devtools/front_end/acorn/LICENSE \
	src/3rdparty/chromium/third_party/WebKit/Source/devtools/front_end/cm/LICENSE \
	src/3rdparty/chromium/third_party/WebKit/Source/devtools/front_end/cm/LICENSE_python \
	src/3rdparty/chromium/third_party/WebKit/Source/devtools/front_end/cm_modes/LICENSE \
	src/3rdparty/chromium/third_party/WebKit/Source/devtools/front_end/gonzales/MIT-LICENSE.txt \
	src/3rdparty/chromium/third_party/WebKit/Source/wtf/dtoa/LICENSE \
	src/3rdparty/chromium/third_party/WebKit/Tools/Scripts/webkitpy/thirdparty/wpt/wpt/LICENSE \
	src/3rdparty/chromium/third_party/WebKit/Tools/Scripts/webkitpy/thirdparty/wpt/wpt/tools/LICENSE \
	src/3rdparty/chromium/third_party/WebKit/Tools/Scripts/webkitpy/thirdparty/wpt/wpt/tools/wptserve/LICENSE \
	src/3rdparty/chromium/third_party/webpagereplay/third_party/dns/LICENSE \
	src/3rdparty/chromium/third_party/webpagereplay/third_party/ipfw_win32/LICENSE \
	src/3rdparty/chromium/third_party/webpagereplay/third_party/jsmin/LICENSE.txt \
	src/3rdparty/chromium/third_party/webrtc/examples/androidapp/third_party/autobanh/LICENSE \
	src/3rdparty/chromium/third_party/webrtc/examples/androidapp/third_party/autobanh/LICENSE.md \
	src/3rdparty/chromium/third_party/webrtc/examples/objc/AppRTCDemo/third_party/SocketRocket/LICENSE \
	src/3rdparty/chromium/third_party/webrtc/LICENSE \
	src/3rdparty/chromium/third_party/webrtc/LICENSE_THIRD_PARTY \
	src/3rdparty/chromium/third_party/woff2/LICENSE \
	src/3rdparty/chromium/third_party/x86inc/LICENSE \
	src/3rdparty/chromium/third_party/xdg-utils/LICENSE \
	src/3rdparty/chromium/third_party/zlib/LICENSE \
	src/3rdparty/chromium/tools/gyp/LICENSE \
	src/3rdparty/chromium/tools/origin_trials/third_party/ed25519/LICENSE \
	src/3rdparty/chromium/tools/page_cycler/acid3/LICENSE \
	src/3rdparty/chromium/tools/win/ChromeDebug/ChromeDebug/LICENSE \
	src/3rdparty/chromium/url/third_party/mozilla/LICENSE.txt \
	src/3rdparty/chromium/v8/LICENSE \
	src/3rdparty/chromium/v8/LICENSE.fdlibm \
	src/3rdparty/chromium/v8/LICENSE.strongtalk \
	src/3rdparty/chromium/v8/LICENSE.v8 \
	src/3rdparty/chromium/v8/LICENSE.valgrind \
	src/3rdparty/chromium/v8/src/third_party/fdlibm/LICENSE \
	src/3rdparty/chromium/v8/src/third_party/valgrind/LICENSE \
	src/3rdparty/chromium/v8/src/third_party/vtune/LICENSE \

