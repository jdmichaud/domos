## host/docker/buildroot/configs/raspberrypi0_defconfig
```kconfig
BR2_arm=y
BR2_arm1176jzf_s=y
BR2_JLEVEL=3
BR2_PACKAGE_HOST_LINUX_HEADERS_CUSTOM_4_9=y
BR2_TOOLCHAIN_BUILDROOT_WCHAR=y
BR2_TOOLCHAIN_BUILDROOT_CXX=y
BR2_TARGET_GENERIC_HOSTNAME="domoscamera"
BR2_TARGET_GENERIC_ISSUE="Welcome to Domos Camera"
BR2_ROOTFS_DEVICE_CREATION_DYNAMIC_MDEV=y
BR2_ROOTFS_OVERLAY="../buildroot/overlays/ezwifi/ ../buildroot/overlays/rpi0_w/"
BR2_ROOTFS_POST_BUILD_SCRIPT="../buildroot/board/raspberrypi0/increase_gpu_mem.sh ../buildroot/board/raspberrypi0/fix_uart.sh board/raspberrypi0/post-build.sh"
BR2_ROOTFS_POST_IMAGE_SCRIPT="board/raspberrypi0/post-image.sh"
BR2_LINUX_KERNEL=y
BR2_LINUX_KERNEL_CUSTOM_GIT=y
BR2_LINUX_KERNEL_CUSTOM_REPO_URL="https://github.com/raspberrypi/linux.git"
BR2_LINUX_KERNEL_CUSTOM_REPO_VERSION="9126e25b0934bd7bd843763310ea4b34c6e139d0"
BR2_LINUX_KERNEL_DEFCONFIG="bcmrpi"
BR2_LINUX_KERNEL_DTS_SUPPORT=y
BR2_LINUX_KERNEL_INTREE_DTS_NAME="bcm2708-rpi-b-plus bcm2708-rpi-0-w"
BR2_PACKAGE_BUSYBOX_SHOW_OTHERS=y
BR2_PACKAGE_GSTREAMER1=y
BR2_PACKAGE_GST1_PLUGINS_BASE_PLUGIN_VIDEOCONVERT=y
BR2_PACKAGE_GST1_PLUGINS_BASE_PLUGIN_VIDEOTESTSRC=y
BR2_PACKAGE_GST1_PLUGINS_BASE_PLUGIN_VIDEORATE=y
BR2_PACKAGE_GST1_PLUGINS_GOOD=y
BR2_PACKAGE_GST1_PLUGINS_GOOD_PLUGIN_MULTIFILE=y
BR2_PACKAGE_GST1_PLUGINS_GOOD_PLUGIN_V4L2=y
BR2_PACKAGE_GST1_PLUGINS_BAD=y
BR2_PACKAGE_GST1_PLUGINS_BAD_PLUGIN_MPEGTSMUX=y
BR2_PACKAGE_GST1_PLUGINS_BAD_PLUGIN_VIDEOPARSERS=y
BR2_PACKAGE_GST1_PLUGINS_BAD_PLUGIN_HLS=y
BR2_PACKAGE_GST1_PLUGINS_UGLY=y
BR2_PACKAGE_GST1_PLUGINS_UGLY_PLUGIN_X264=y
BR2_PACKAGE_GST_OMX=y
BR2_PACKAGE_RPI_FIRMWARE=y
# BR2_PACKAGE_RPI_FIRMWARE_INSTALL_DTB_OVERLAYS is not set
BR2_PACKAGE_RPI_WIFI_FIRMWARE=y
BR2_PACKAGE_RPI_USERLAND=y
BR2_PACKAGE_DROPBEAR=y
BR2_PACKAGE_THTTPD=y
BR2_PACKAGE_WIRELESS_TOOLS=y
BR2_PACKAGE_WPA_SUPPLICANT=y
BR2_PACKAGE_WPA_SUPPLICANT_CLI=y
BR2_PACKAGE_WPA_SUPPLICANT_WPA_CLIENT_SO=y
BR2_PACKAGE_WPA_SUPPLICANT_PASSPHRASE=y
BR2_PACKAGE_BASH=y
BR2_PACKAGE_DIALOG=y
BR2_TARGET_ROOTFS_EXT2=y
BR2_TARGET_ROOTFS_EXT2_4=y
BR2_TARGET_ROOTFS_EXT2_SIZE="1G"
# BR2_TARGET_ROOTFS_TAR is not set
BR2_PACKAGE_HOST_DOSFSTOOLS=y
BR2_PACKAGE_HOST_GENIMAGE=y
BR2_PACKAGE_HOST_MTOOLS=y
```

## host/docker/buildroot/configs/raspberrypi2_defconfig
```kconfig
BR2_arm=y
BR2_cortex_a7=y
BR2_ARM_FPU_NEON_VFPV4=y
BR2_JLEVEL=3
BR2_CCACHE=y
# BR2_STRIP_strip is not set
BR2_SHARED_STATIC_LIBS=y
BR2_GLOBAL_PATCH_DIR="../buildroot/patches"
BR2_TOOLCHAIN_BUILDROOT_GLIBC=y
BR2_PACKAGE_HOST_LINUX_HEADERS_CUSTOM_4_4=y
BR2_TOOLCHAIN_BUILDROOT_CXX=y
BR2_TARGET_GENERIC_HOSTNAME="domoscontroller"
BR2_TARGET_GENERIC_ISSUE="Welcome to Domos"
BR2_ROOTFS_DEVICE_CREATION_DYNAMIC_EUDEV=y
BR2_SYSTEM_DHCP="eth0"
BR2_ROOTFS_OVERLAY="../buildroot/overlays/ap/ ../buildroot/overlays/kiosk/"
BR2_ROOTFS_POST_BUILD_SCRIPT="../buildroot/board/raspberrypi2/post-build.sh"
BR2_ROOTFS_POST_IMAGE_SCRIPT="board/raspberrypi2/post-image.sh"
BR2_LINUX_KERNEL=y
BR2_LINUX_KERNEL_CUSTOM_TARBALL=y
BR2_LINUX_KERNEL_CUSTOM_TARBALL_LOCATION="https://github.com/raspberrypi/linux/archive/raspberrypi-kernel_1.20170303-1.tar.gz"
BR2_LINUX_KERNEL_DEFCONFIG="bcm2709"
BR2_LINUX_KERNEL_DTS_SUPPORT=y
BR2_LINUX_KERNEL_INTREE_DTS_NAME="bcm2709-rpi-2-b"
BR2_PACKAGE_BUSYBOX_CONFIG="../buildroot/package/busybox/busybox.config"
BR2_PACKAGE_BUSYBOX_SHOW_OTHERS=y
BR2_PACKAGE_FFMPEG_FFPLAY=y
BR2_PACKAGE_FFMPEG_FFSERVER=y
BR2_PACKAGE_FFMPEG_FFPROBE=y
BR2_PACKAGE_PV=y
BR2_PACKAGE_LIBERATION=y
BR2_PACKAGE_QT5=y
BR2_PACKAGE_QT5BASE_EXAMPLES=y
BR2_PACKAGE_QT5WEBENGINE=y
BR2_PACKAGE_QT5WEBENGINE_PROPRIETARY_CODECS=y
BR2_PACKAGE_QT_WEBKIT_KIOSK=y
BR2_PACKAGE_RPI_FIRMWARE=y
# BR2_PACKAGE_RPI_FIRMWARE_INSTALL_DTB_OVERLAYS is not set
BR2_PACKAGE_RPI_USERLAND=y
BR2_PACKAGE_LIBDAEMON=y
BR2_PACKAGE_DHCP=y
BR2_PACKAGE_DHCP_SERVER=y
BR2_PACKAGE_DHCP_SERVER_DELAYED_ACK=y
BR2_PACKAGE_DROPBEAR=y
BR2_PACKAGE_HOSTAPD=y
BR2_PACKAGE_IPERF3=y
BR2_PACKAGE_WIRELESS_TOOLS=y
BR2_PACKAGE_WPA_SUPPLICANT=y
BR2_PACKAGE_WPA_SUPPLICANT_AP_SUPPORT=y
BR2_PACKAGE_WPA_SUPPLICANT_WPS=y
BR2_PACKAGE_WPA_SUPPLICANT_CLI=y
BR2_PACKAGE_WPA_SUPPLICANT_WPA_CLIENT_SO=y
BR2_PACKAGE_WPA_SUPPLICANT_PASSPHRASE=y
BR2_PACKAGE_BASH=y
BR2_PACKAGE_DIALOG=y
BR2_PACKAGE_433UTILS=y
BR2_PACKAGE_RF24=y
BR2_PACKAGE_QT5WEBVIEW=y
BR2_PACKAGE_RECEIVER=y
BR2_PACKAGE_KIOSK=y
BR2_TARGET_ROOTFS_EXT2=y
BR2_TARGET_ROOTFS_EXT2_4=y
BR2_TARGET_ROOTFS_EXT2_SIZE="1048576"
# BR2_TARGET_ROOTFS_TAR is not set
BR2_PACKAGE_HOST_DOSFSTOOLS=y
BR2_PACKAGE_HOST_GENIMAGE=y
BR2_PACKAGE_HOST_MTOOLS=y
```

## host/docker/buildroot/package/433Utils/Config.in
```kconfig
config BR2_PACKAGE_433UTILS
  bool "433Utils"
  select BR2_PACKAGE_WIRINGPI  
  help
    433Kit is a collection of code and documentation designed to assist you in
    the connection and usage of RF 433MHz transmit and receive modules to/with
    your Arduino and Rapberry Pi.

    https://github.com/ninjablocks/433Utils
```

## host/docker/buildroot/package/RF24/Config.in
```kconfig
config BR2_PACKAGE_RF24
	bool "RF24"
	help
	  A library for NRF24L01(+) communication.

	  https://github.com/nRF24/RF24.git
```

## host/docker/buildroot/package/domos/frontend/Config.in
```kconfig
config BR2_PACKAGE_FRONTEND
    bool "frontend"
    help
      The Domos frontend application

      http://github.com/jdmichaud/domos/rpi/frontend
```

## host/docker/buildroot/package/domos/kiosk/Config.in
```kconfig
config BR2_PACKAGE_KIOSK
    bool "kiosk"
    depends on BR2_PACKAGE_QT5
    depends on BR2_PACKAGE_RPI_USERLAND
    select BR2_PACKAGE_QT5BASE_GUI
    select BR2_PACKAGE_QT5DECLARATIVE
    select BR2_PACKAGE_QT5DECLARATIVE_QUICK
    select BR2_PACKAGE_QT5WEBKIT
    select BR2_PACKAGE_QT5_GL_AVAILABLE
    help
      A lightweight Qt5/Webkit based full screen browser to be used on a kiosk
      application

      http://github.com/jdmichaud/kiosk

comment "kiosk depends on QT5 library"
    depends on !BR2_PACKAGE_QT5

comment "kiosk depends on BR2_PACKAGE_RPI_USERLAND"
    depends on !BR2_PACKAGE_RPI_USERLAND
```

## host/docker/buildroot/package/domos/libhttp/Config.in
```kconfig
config BR2_PACKAGE_LIBHTTP
	bool "libhttp"
	select BR2_PACKAGE_LIBCURL
	help
	  A library providing a simple API to perform HTTP request from C++

	  http://github.com/jdmichaud/domos
```

## host/docker/buildroot/package/domos/librfprotocol/Config.in
```kconfig
config BR2_PACKAGE_LIBRFPROTOCOL
	bool "librfprotocol"
	help
	  A library to manipulate a simple protocol based on 64 bits of data

	  http://github.com/jdmichaud/domos
 
```

## host/docker/buildroot/package/domos/receiver/Config.in
```kconfig
# By default, buildroot build only shared libraries (including wiringPi)
# Receiver depends on static libraries to simplify linking with wiringPi
# We might change this later...
config BR2_PACKAGE_RECEIVER
	bool "receiver"
	select BR2_PACKAGE_LIBHTTP
	select BR2_PACKAGE_RCSWITCH
	select BR2_PACKAGE_LIBRFPROTOCOL
	depends on BR2_STATIC_LIBS || BR2_SHARED_STATIC_LIBS
	help
	  Receiver is used to catch signals emitted by sensors through multiple
	  channels and produce a REST call to the domos backend.

	  http://github.com/jdmichaud/domos

comment "receiver needs a toolchain w/ static library"
	depends on !BR2_STATIC_LIBS && !BR2_SHARED_STATIC_LIBS
```

## host/docker/buildroot/package/qt5webengine/Config.in
```kconfig
config BR2_PACKAGE_QT5WEBENGINE
    bool "qt5webengine"
    depends on BR2_PACKAGE_QT5_JSCORE_AVAILABLE
    depends on BR2_TOOLCHAIN_BUILDROOT_USE_SSP
    select BR2_PACKAGE_QT5BASE
    select BR2_PACKAGE_QT5BASE_GUI
    select BR2_PACKAGE_QT5BASE_FONTCONFIG
    select BR2_PACKAGE_QT5BASE_DBUS
    select BR2_PACKAGE_QT5BASE_ICU
    select BR2_PACKAGE_QT5DECLARATIVE
    select BR2_PACKAGE_QT5WEBCHANNEL
    select BR2_PACKAGE_FFMPEG
    select BR2_PACKAGE_OPUS
    select BR2_PACKAGE_LIBVPX
    select BR2_PACKAGE_WEBP
    select BR2_PACKAGE_WEBP_DEMUX
    select BR2_PACKAGE_OPENSSL
    select BR2_PACKAGE_LIBCAP
    select BR2_PACKAGE_LIBGLIB2
    select BR2_PACKAGE_XLIB_LIBXCOMPOSITE if BR2_PACKAGE_QT5BASE_XCB
    select BR2_PACKAGE_XLIB_LIBXCURSOR if BR2_PACKAGE_QT5BASE_XCB
    select BR2_PACKAGE_XLIB_LIBXI if BR2_PACKAGE_QT5BASE_XCB
    select BR2_PACKAGE_XLIB_LIBXRANDR if BR2_PACKAGE_QT5BASE_XCB
    select BR2_PACKAGE_XLIB_LIBXSCRNSAVER if BR2_PACKAGE_QT5BASE_XCB
    select BR2_PACKAGE_XLIB_LIBXTST if BR2_PACKAGE_QT5BASE_XCB
	help
    QtWebEngine integrates chromium's fast moving web capabilities into Qt.

    Our goal is to bring the latest and best implementation of the web platform
    into the universe of Qt. It is not just a port of the core HTML/CSS
    rendering engine, it is the entire Chromium platform. The integration with

    Qt focuses on an API that is easy to use, yet extensible. We also make no
    compromise on the graphics integration, integrating the layer rendering of
    Chromium directly into the OpenGL scene graph of QtQuick.

    http://doc.qt.io/archives/qt-5.8/qtwebengine-index.html

comment "qt5webengine needs a toolchain w/ dynamic library"
	depends on BR2_STATIC_LIBS

comment "qt5webengine needs BR2_PACKAGE_QT5_JSCORE_AVAILABLE"
  depends on !BR2_PACKAGE_QT5_JSCORE_AVAILABLE

comment "qt5webengine needs a toolchain w/ stack smashing protection"
  depends on !BR2_TOOLCHAIN_BUILDROOT_USE_SSP
```

## host/docker/buildroot/package/qt5webview/Config.in
```kconfig
config BR2_PACKAGE_QT5WEBVIEW
    bool "qt5webview"
    depends on BR2_PACKAGE_QT5WEBENGINE
	help
    QtWebview

    http://doc.qt.io/archives/qt-5.8/qtwebview-index.html

comment "qt5webview needs BR2_PACKAGE_QT5WEBENGINE"
	depends on !BR2_PACKAGE_QT5WEBENGINE
```

## host/docker/buildroot/package/rcswitch/Config.in
```kconfig
config BR2_PACKAGE_RCSWITCH
	bool "rcswitch"
	select BR2_PACKAGE_WIRINGPI
	help
	  Arduino lib to operate 433/315Mhz devices like power outlet sockets.

	  https://github.com/sui77/rc-switch
```

## host/docker/buildroot/package/set_overscan/Config.in
```kconfig
config BR2_PACKAGE_RPI_SET_OVERSCAN
	bool "set_overscan"
	help
	  A tool to dyncamically set the overscan on RPi.

	  https://github.com/ukscone/set_overscan
```
